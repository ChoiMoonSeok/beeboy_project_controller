#include <SoftwareSerial.h>
#include "U8glib.h"
U8GLIB_SSD1306_128X64 u8g(U8G_I2C_OPT_NONE|U8G_I2C_OPT_DEV_0);

const int led=13;
#define RX 3
#define TX 2
SoftwareSerial mySerial(RX,TX);

#define L_IN1 7
#define L_IN2 4
#define R_IN1 A1
#define R_IN2 A3
#define PWM_L 6
#define PWM_R 5

//led color
#define LED_GREEN 9
#define LED_RED 10
#define LED_BLUE 11


// oled

// 'asiana', 128x64px
const unsigned char epd_bitmap_logo [] PROGMEM = {
  0x7f, 0xff, 0xff, 0xff, 0xff, 0xff, 0xff, 0xff, 0xff, 0xff, 0xff, 0xff, 0xff, 0xff, 0xff, 0xfe, 
  0xff, 0xff, 0xff, 0xff, 0xff, 0xff, 0xff, 0x80, 0x0f, 0xff, 0xff, 0xff, 0xff, 0xff, 0xff, 0xff, 
  0xff, 0xff, 0xff, 0xff, 0xff, 0xff, 0xf0, 0x00, 0x00, 0xff, 0xff, 0xff, 0xff, 0xff, 0xff, 0xff, 
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  0x7f, 0xff, 0xff, 0xff, 0xff, 0xff, 0xff, 0xff, 0xff, 0xff, 0xff, 0xff, 0xff, 0xff, 0xff, 0xfe
};

// Array of all bitmaps for convenience. (Total bytes used to store images in PROGMEM = 1040)
const int epd_bitmap_allArray_LEN = 1;
const unsigned char* epd_bitmap_allArray[1] = {
  epd_bitmap_logo
};


void draw(){ // oled picture drawing
  u8g.setPrintPos(0,0);
  u8g.drawBitmapP(0, 0, 16, 64, epd_bitmap_logo); 
  
}

void moving(int L1, int L2, int R1, int R2, int PWML, int PWMR){//이동
  digitalWrite(L_IN1, L1);
  digitalWrite(L_IN2, LB2);
  analogWrite(PWM_L, PWML);
  digitalWrite(R_IN1, R1);
  digitalWrite(R_IN2, R2);
  analogWrite(PWM_R, PWMR);
}

void setup() {
  // put your setup code here, to run once:
  Serial.begin(9600);
  mySerial.begin(9600);
  
  pinMode(L_IN1, OUTPUT);
  pinMode(L_IN2, OUTPUT);
  pinMode(R_IN1, OUTPUT);
  pinMode(R_IN2, OUTPUT);
  pinMode(PWM_L, OUTPUT);
  pinMode(PWM_R, OUTPUT);
  pinMode(9,OUTPUT);
  pinMode(10,OUTPUT);
  pinMode(11,OUTPUT);

  digitalWrite(LED_RED, HIGH); // led 초기화
  digitalWrite(LED_GREEN, HIGH); 
  digitalWrite(LED_BLUE, HIGH);

  u8g.setFont(u8g_font_unifont); // 폰트지정
  u8g.setColorIndex(1);

  u8g.firstPage(); // 폰트 설정
  do{
    draw();
  }while(u8g.nextPage());
  
}

char btbuf;



void loop() {
  // put your main code here, to run repeatedly:
   
  if (mySerial.available()){
  
    btbuf=mySerial.read();

    Serial.println(btbuf);
    Serial.println(HIGH);
    if ('U'==btbuf){//전진
      moving(LOW, HIGH, LOW, HIGH, 200, 200);
    }
    else if ('u'==btbuf){
      moving(HIGH, HIGH, HIGH, HIGH, 0, 0);//정지
    }
    else if ('R'==btbuf){//우회전
      moving(LOW, HIGH, LOW, HIGH, 200, 100);
    }
    else if ('r'==btbuf){
      moving(HIGH, HIGH, HIGH, HIGH, 0, 0);//정지 
    }
    else if ('L'==btbuf){//좌회전
      moving(LOW, HIGH, LOW, HIGH, 100, 200);//좌회전
    }
    else if ('l'==btbuf){
      moving(HIGH, HIGH, HIGH, HIGH, 0, 0);//정지
    }
    else if ('D'==btbuf){//후진
      moving(HIGH, LOW, HIGH, LOW, 200, 200);//정지
    }
    else if ('d'==btbuf){
      moving(HIGH, HIGH, HIGH, HIGH, 0, 0);//정지
    }
    else if ('E'==btbuf){//오른쪽 제자리
      moving(HIGH, LOW, LOW, HIGH, 200, 200);//정지
    }
    else if ('e'==btbuf){
      moving(HIGH, HIGH, HIGH, HIGH, 0, 0);//정지
    }
    else if ('B'==btbuf){//왼쪽 제자리
      moving(LOW, HIGH, HIGH, LOW, 200, 200);//정지
    }
    else if ('b'==btbuf){
      moving(HIGH, HIGH, HIGH, HIGH, 0, 0);//정지
    }
    if ('F'==btbuf){//전진
      moving(LOW, HIGH, LOW, HIGH, 250, 250);
      delay(1000);
    }
    else if ('f'==btbuf){
      moving(HIGH, HIGH, HIGH, HIGH, 0, 0);//정지
    }
    if ('A'==btbuf){// led on
      analogWrite(LED_RED, 254);
      analogWrite(LED_GREEN, 84);
      analogWrite(LED_BLUE, 0);
      
    }
    if ('S'==btbuf){// led off
      digitalWrite(LED_BLUE, HIGH);
      digitalWrite(LED_RED, HIGH);
      digitalWrite(LED_GREEN, HIGH);
    }
    if ('C'==btbuf){
      moving(HIGH, HIGH, HIGH, HIGH, 255, 255);//정지
    }
  }
  
  
  
}
